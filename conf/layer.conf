## conf/layer.conf
```bitbake
# We have a conf and classes directory, add to BBPATH
BBPATH .= ":${LAYERDIR}"

BBFILE_COLLECTIONS += "meta-sfos-librespot"

# We have recipes-* directories, add to BBFILES
BBFILES += "${LAYERDIR}/recipes-*/*/*.bb \
            ${LAYERDIR}/recipes-*/*/*.bbappend"

BBFILES += "${LAYERDIR}/librespot/*.bb \
            ${LAYERDIR}/images/*.bb"

LAYERSERIES_COMPAT_meta-sfos-librespot = "thud dunfell kirkstone"

BBFILE_PATTERN_meta-sfos-librespot= "^${LAYERDIR}/"
BBFILE_PRIORITY_meta-sfos-librespot = "5"
LAYERVERSION_meta-sfos-librespot = "2"
```
